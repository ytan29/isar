## meta-ces/conf/machine/pixi-cdl100.conf
```bitbake
DISTRO_ARCH ?= "armhf"

IMAGE_TYPE ?= "targz-img"
IMAGE_INSTALL += " xserver-xorg-video-armada-etnadrm"
```

## meta-isar/conf/distro/ubuntu-focal.conf
```bitbake
#
# Copyright (c) Siemens AG, 2018-2020
#
# SPDX-License-Identifier: MIT

require conf/distro/debian-common.conf

BASE_DISTRO = "ubuntu"

DISTRO_APT_SOURCES ?= "conf/distro/${DISTRO}.list"
DISTRO_APT_SOURCES_arm64 ?= "conf/distro/${DISTRO}-ports.list"
HOST_DISTRO_APT_SOURCES_append_arm64 = " ${DISTRO_APT_SOURCES}"

BOOTSTRAP_KEY = "file://${LAYERDIR_isar}/conf/distro/ubuntu.public.key;sha256sum=36a38199a4bf4eae1e7f574891f7dfcb79b91b87a33a499383265e1224b5e989"
DISTRO_BOOTSTRAP_KEYS += "${BOOTSTRAP_KEY}"
HOST_DISTRO_BOOTSTRAP_KEYS += "${BOOTSTRAP_KEY}"

BASE_DISTRO_CODENAME = "focal"

# that is what debootstrap_1.0.118ubuntu1 does anyways
DISTRO_DEBOOTSTRAP_SCRIPT = "/usr/share/debootstrap/scripts/gutsy"

DISTRO_CONFIG_SCRIPT ?= "debian-configscript.sh"

DISTRO_KERNELS ?= " \
    aws azure azure-edge gcp generic gke kvm lowlatency oem virtual \
    snapdragon generic-lpae"

IMAGE_PREINSTALL += "init"

WIC_IMAGER_INSTALL += "python3-distutils"
```

## meta-isar/conf/machine/agilex.conf
```bitbake
#
# Copyright (c) Siemens AG, 2018
#
# SPDX-License-Identifier: MIT

DISTRO_ARCH ?= "arm64"

KERNEL_NAME ?= "socfpga-lts"

# ECI-MOD: specific for agilex from GSRD
PREFERRED_PROVIDER_u-boot ?= "u-boot-socfpga"
UBOOT_CONFIG ??= "agilex-socdk"
U_BOOT_CONFIG_agilex = "socfpga_agilex_defconfig"
U_BOOT_BIN_agilex = "u-boot-img.bin"

# ECI-MOD: We are not doing DE0 
#PREFERRED_PROVIDER_u-boot-de0-nano-soc = "u-boot-de0-nano-soc"
#U_BOOT_CONFIG_agilex = "socfpga_de0_nano_soc_defconfig"
#U_BOOT_BIN_agilex = "u-boot-with-spl.sfp"

#IMAGE_FSTYPES ?= "wic-img"
IMAGE_FSTYPES ?= "targz-img"

# ECI-MOD: Skipping these for now, doesnt seem to be necessary for now
#WKS_FILE ?= "de0-nano-soc.wks.in"
#IMAGER_INSTALL += "u-boot-de0-nano-soc"
#IMAGER_BUILD_DEPS += "u-boot-de0-nano-soc"

IMAGE_PREINSTALL += "iproute2 python3 util-linux stress-ng mesa-utils libatomic-ops-dev coreutils procps"
IMAGE_INSTALL += "u-boot-tools libubootenv-tool u-boot-script"
```

## meta-isar/conf/machine/virtualbox.conf
```bitbake
# This software is a part of ISAR.
# Copyright (c) Siemens AG, 2020
#
# SPDX-License-Identifier: MIT

DISTRO_ARCH ?= "amd64"

KERNEL_NAME ?= "amd64"
BOOTLOADER ?= "grub"

WKS_FILE ?= "virtualmachine-grub"

IMAGER_INSTALL += "${GRUB_BOOTLOADER_INSTALL}"

VMDK_SUBFORMAT = "monolithicSparse"
IMAGE_TYPE ?= "virtual-machine-image"
```

## meta-isar/scripts/lib/wic/canned-wks/virtualmachine-grub.wks
```
#
# Copyright (c) Siemens AG, 2019
#
# Licensed under the Siemens Inner Source License 1.2, or at your option any
# later version.
#

part /boot --source bootimg-efi-isar --sourceparams "loader=grub-efi" --ondisk sda --label efi --part-type EF00 --align 1024
part / --source rootfs --ondisk sda --fstype ext4 --label platform --align 1024 --use-uuid --size 50G

bootloader --ptable gpt --timeout 3 --append "rootwait console=ttyS0,115200 console=tty0"
```
